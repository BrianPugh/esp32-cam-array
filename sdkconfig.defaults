## sdkconfig.defaults
```kconfig
CONFIG_HTTPD_MAX_REQ_HDR_LEN=1024

CONFIG_FATFS_LONG_FILENAME=y
CONFIG_FATFS_LFN_HEAP=y

CONFIG_ESPTOOLPY_FLASHSIZE_4MB=y
CONFIG_ESPTOOLPY_FLASHSIZE="4MB"

CONFIG_PARTITION_TABLE_CUSTOM=y
CONFIG_PARTITION_TABLE_CUSTOM_FILENAME="partitions.csv"
CONFIG_PARTITION_TABLE_FILENAME="partitions.csv"

CONFIG_ESP32_XTAL_FREQ_AUTO=y
CONFIG_ESPTOOLPY_FLASHFREQ_80m=y
CONFIG_ESPTOOLPY_FLASHMODE_QIO=y
CONFIG_NEWLIB_NANO_FORMAT=y

CONFIG_ESP32_DEFAULT_CPU_FREQ_MHZ_240=y

# For some reason, required by the camera drivers
CONFIG_TCIO_SUPPORT_RTC_GPIO_DESC=y

#########
# PSRAM #
#########
CONFIG_ESP32_SPIRAM_SUPPORT=y
CONFIG_SPIRAM_SPEED_80m=y
```
